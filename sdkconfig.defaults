## sdkconfig.defaults
```kconfig
# === Major savings ===
CONFIG_BT_ENABLED=n
CONFIG_ETH_ENABLED=n
CONFIG_LWIP_IPV6=n
CONFIG_MBEDTLS_CERTIFICATE_BUNDLE=n

# === Minor savings ===
CONFIG_LWIP_PPP_SUPPORT=n
CONFIG_ESP_WIFI_ENTERPRISE_SUPPORT=n
CONFIG_ESP_WIFI_CSI_ENABLED=n

# === Test/Debug infrastructure ===
CONFIG_UNITY_ENABLE_IDF_TEST_RUNNER=n
CONFIG_GDBSTUB_SUPPORT_TASKS=n
CONFIG_COMPILER_OPTIMIZATION_ASSERTIONS_DISABLE=y
CONFIG_COMPILER_STACK_CHECK_MODE_NORM=n

# === FreeRTOS stats ===
CONFIG_FREERTOS_USE_TRACE_FACILITY=n
CONFIG_FREERTOS_USE_STATS_FORMATTING_FUNCTIONS=n
CONFIG_FREERTOS_GENERATE_RUN_TIME_STATS=n
```
